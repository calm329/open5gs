# 1 "dts/usrp_e310_sg3_idle_fpga.dts"
# 1 "<built-in>"
# 1 "<command-line>"
# 1 "dts/usrp_e310_sg3_idle_fpga.dts"






/dts-v1/;
/plugin/;

# 1 "dts/e31x-sg3-idle-fpga.dtsi" 1






&fpga_full {
 firmware-name = "e310_sg3_idle.bin";
};
# 11 "dts/usrp_e310_sg3_idle_fpga.dts" 2
# 1 "dts/e31x-pmu.dtsi" 1






&fpga_full {
 devctrl: devctrl@40000000 {
  compatible = "syscon";
  reg = <0x40000000 0x24>;
 };
 poweroff {
  compatible = "syscon-poweroff";
  regmap = <&devctrl>;
  offset = <0x0>;
  mask = <0x7a>;
 };
 pmu {
  compatible = "ni,e31x-pmu";
  regmap = <&devctrl>;
  status = "okay";
  charger: charger@0{
   compatible = "ni,e31x-charger";
  };
  battery: battery@1{
   compatible = "ni,e31x-battery";
  };
 };
};
# 11 "dts/usrp_e310_sg3_idle_fpga.dts" 2
